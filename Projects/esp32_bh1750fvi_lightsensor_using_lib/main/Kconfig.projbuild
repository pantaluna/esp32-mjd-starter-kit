## Projects/esp32_bh1750fvi_lightsensor_using_lib/main/Kconfig.projbuild
```kconfig
menu "MY PROJECT configuration"

config MY_LED_ON_DEVBOARD_GPIO_NUM
    int "LED on-board GPIO# (Huzzah32 #13) (Lolin32lite #22)"
	default 13

config MY_LED_ON_DEVBOARD_WIRING_TYPE
    int "LED on-board wiring type (Huzzah32 1=GND) (Lolin32lite 2=VCC)"
	default 1

config MY_LIGHT_SENSOR_I2C_MASTER_NUM
    int "MY_LIGHT_SENSOR_I2C_MASTER_NUM (0 = I2C_NUM_0 | 1 = I2C_NUM_1)"
	default 0

config MY_LIGHT_SENSOR_I2C_SLAVE_ADDRESS
    hex "MY_LIGHT_SENSOR_I2C_SLAVE_ADDRESS (Default 0x23 | 0x5C)"
	default 0x23

config MY_LIGHT_SENSOR_I2C_SCLK_GPIO_NUM
    int "MY_LIGHT_SENSOR_I2C_SCLK_GPIO_NUM ((Huzzah32 21 bottomleft)"
	default 21

config MY_LIGHT_SENSOR_I2C_SDA_GPIO_NUM
    int "MY_SENSOR_I2C_SDA_GPIO_NUM ((Huzzah32 17 bottomleft-1)"
	default 17
	
endmenu
```

## Projects/esp32_bme280_sensor_using_lib/main/Kconfig.projbuild
```kconfig
menu "MY PROJECT configuration"

config MY_LED_ON_DEVBOARD_GPIO_NUM
    int "LED on-board GPIO# (Huzzah32 #13) (Lolin32lite #22)"
	default 13

config MY_LED_ON_DEVBOARD_WIRING_TYPE
    int "LED on-board wiring type (Huzzah32 1=GND) (Lolin32lite 2=VCC)"
	default 1

config MY_TEMPERATURE_SENSOR_I2C_MASTER_NUM
    int "MY_TEMPERATURE_SENSOR_I2C_MASTER_NUM (0 = I2C_NUM_0 | 1 = I2C_NUM_1)"
	default 0

config MY_TEMPERATURE_SENSOR_I2C_SLAVE_ADDRESS
    hex "MY_TEMPERATURE_SENSOR_I2C_SLAVE_ADDRESS (Default 0x76 | 0x77)"
	default 0x76

config MY_TEMPERATURE_SENSOR_I2C_SCLK_GPIO_NUM
    int "MY_TEMPERATURE_SENSOR_I2C_SCLK_GPIO_NUM ((Huzzah32 21 bottomleft)(Lolin32lite 13 bottomleft)"
	default 21

config MY_TEMPERATURE_SENSOR_I2C_SDA_GPIO_NUM
    int "MY_TEMPERATURE_SENSOR_I2C_SDA_GPIO_NUM ((Huzzah32 17 bottomleft-1)(Lolin32lite 15 bottomleft-1)"
	default 17
	
endmenu
```

## Projects/esp32_dht22_temperature_sensor_using_lib/main/Kconfig.projbuild
```kconfig
menu "MY PROJECT configuration"

config MY_LED_ON_DEVBOARD_GPIO_NUM
    int "LED on-board GPIO# (Huzzah32 #13) (Lolin32lite #22)"
	default 13

config MY_LED_ON_DEVBOARD_WIRING_TYPE
    int "LED on-board wiring type (Huzzah32 1=GND) (Lolin32lite 2=VCC)"
	default 1

config MY_TEMPERATURE_SENSOR_1WIRE_GPIO_NUM
    int "Temperature sensor 1-Wire GPIO# (Huzzah32 GPIO#14: bottomright-2)(Lolin32lite GPIO#19: topright+2)"
	default 14

endmenu
```

## Projects/esp32_i2c_scanner/main/Kconfig.projbuild
```kconfig
menu "MY PROJECT configuration"

config MY_SCANNER_I2C_MASTER_NUM
    int "MY_SCANNER_I2C_MASTER_NUM (0 = I2C_NUM_0 | 1 = I2C_NUM_1)"
	default 0

config MY_SCANNER_I2C_SCLK_GPIO_NUM
    int "MY_SCANNER_I2C_SCLK_GPIO_NUM (Huzzah32 #21 bottomleft)(Lolin32lite #13 bottomleft)"
	default 21

config MY_SCANNER_I2C_SDA_GPIO_NUM
    int "MY_SCANNER_I2C_SDA_GPIO_NUM (Huzzah32 #17 bottomleft-1)(Lolin32lite #15 bottomleft-1)"
	default 17
	
endmenu
```

## Projects/esp32_jsnsr04t_oled_mosfet_using_lib/main/Kconfig.projbuild
```kconfig
menu "MY PROJECT configuration"

##
## LED on-board
choice MY_LED_ON_DEVBOARD_GPIO_NUM
    prompt "On-board LED GPIO#"
    default MY_LED_ON_DEVBOARD_GPIO_NUM_HUZZAH32_13
    help
        The on-board LED GPIO# to be used.
config MY_LED_ON_DEVBOARD_GPIO_NUM_HUZZAH32_13
    bool "HUZZAH32 GPIO#13"
config MY_LED_ON_DEVBOARD_GPIO_NUM_LOLIN32LITE_22
    bool "LOLIN32LITE GPIO#22"
config MY_LED_ON_DEVBOARD_GPIO_NUM_OTHER
    bool "Other GPIO#"
endchoice
config MY_LED_ON_DEVBOARD_GPIO_NUM_OTHER_VAL
    int "Other On-board LED GPIO#" if MY_LED_ON_DEVBOARD_GPIO_NUM_OTHER
    default 99
config MY_LED_ON_DEVBOARD_GPIO_NUM
    int
    default 13 if MY_LED_ON_DEVBOARD_GPIO_NUM_HUZZAH32_13
    default 22 if MY_LED_ON_DEVBOARD_GPIO_NUM_LOLIN32LITE_22
    default MY_LED_ON_DEVBOARD_GPIO_NUM_OTHER_VAL if MY_LED_ON_DEVBOARD_GPIO_NUM_OTHER


choice MY_LED_ON_DEVBOARD_WIRING_TYPE
    prompt "LED on-board wiring type"
    default MY_LED_ON_DEVBOARD_WIRING_TYPE_HUZZAH32_GND_1
    help
        The LED on-board wiring type to be used.
config MY_LED_ON_DEVBOARD_WIRING_TYPE_HUZZAH32_GND
    bool "HUZZAH32 GND"
config MY_LED_ON_DEVBOARD_WIRING_TYPE_LOLIN32LITE_VCC
    bool "LOLIN32LITE VCC"
endchoice
config MY_LED_ON_DEVBOARD_WIRING_TYPE
    int
    default 1 if MY_LED_ON_DEVBOARD_WIRING_TYPE_HUZZAH32_GND
    default 2 if MY_LED_ON_DEVBOARD_WIRING_TYPE_LOLIN32LITE_VCC

##
## Sensor JSN-SR04T
config MY_JSNSR04T_TRIGGER_GPIO_NUM
    int "MY_JSNSR04T_TRIGGER_GPIO_NUM (Huzzah32 GPIO#16 = bottomleft-2)"
    default 16

config MY_JSNSR04T_ECHO_GPIO_NUM
    int "MY_JSNSR04T_ECHO_GPIO_NUM (Huzzah32 GPIO#14 = bottomright-2)"
    default 14

##
## OLED SSD1306
choice MY_SSD1306_OLED_IS_USED
    prompt "Use OLED Display? [default Yes]"
    default MY_SSD1306_OLED_IS_USED_YES
config MY_SSD1306_OLED_IS_USED_YES
    bool "Yes"
config MY_SSD1306_OLED_IS_USED_NO
    bool "No"
endchoice
config MY_SSD1306_OLED_IS_USED
    int
    default 1 if MY_SSD1306_OLED_IS_USED_YES
    default 0 if MY_SSD1306_OLED_IS_USED_NO

config MY_SSD1306_I2C_SLAVE_ADDRESS
    hex "MY_SSD1306_I2C_SLAVE_ADDRESS (default 0x3C for SSD1306)"
    default 0x3C
 
config MY_SSD1306_I2C_MASTER_PORT_NUM
    int "MY_SSD1306_I2C_MASTER_PORT_NUM (0 = I2C_NUM_0 | 1 = I2C_NUM_1)"
    default 0

config MY_SSD1306_I2C_SCL_GPIO_NUM
    int "MY_SSD1306_I2C_SCL_GPIO_NUM (Huzzah32 GPIO#21 = bottomleft)"
    default 21
    
config MY_SSD1306_I2C_SDA_GPIO_NUM
    int "MY_SSD1306_I2C_SDA_GPIO_NUM (Huzzah32 GPIO#17 = bottomleft-1)"
    default 17

config MY_SSD1306_OLED_DIMENSION_NUM
    int "MY_SSD1306_OLED_DIMENSION_NUM (0 = 128x32 | 1 = 128x64)"
    default 0

##
## N Channel POWER MOSFET.
choice MY_POWER_MOSFET_IS_USED
    prompt "Use Power MOSFET N Channel (control power to sensor)? [default Yes]"
    default MY_POWER_MOSFET_IS_USED_YES
config MY_POWER_MOSFET_IS_USED_YES
    bool "Yes"
config MY_POWER_MOSFET_IS_USED_NO
    bool "No"
endchoice
config MY_POWER_MOSFET_IS_USED
    int
    default 1 if MY_POWER_MOSFET_IS_USED_YES
    default 0 if MY_POWER_MOSFET_IS_USED_NO

config MY_POWER_MOSFET_GATE_GPIO_NUM
    int "MY_POWER_MOSFET_GATE_GPIO_NUM (Huzzah32 GPIO#4 = bottomleft-6)"
    default 4

endmenu
```

## Projects/esp32_ledrgb_using_lib/main/Kconfig.projbuild
```kconfig
menu "MY PROJECT configuration"

config MY_1WIRE_GPIO_NUM
    int "MY_1WIRE_GPIO_NUM ((Huzzah32 #14 @ bottomright-2))"
    default 14

endmenu
```

## Projects/esp32_ledrgb_using_lib/sdkconfig.defaults
```kconfig
#
# Compiler options
#
CONFIG_OPTIMIZATION_LEVEL_DEBUG=y
CONFIG_OPTIMIZATION_LEVEL_RELEASE=

CONFIG_STACK_CHECK_NONE=
CONFIG_STACK_CHECK_NORM=
CONFIG_STACK_CHECK_STRONG=
CONFIG_STACK_CHECK_ALL=y
CONFIG_STACK_CHECK=y

#
# Component => ESP-32 Specific => CPU Frequency := 240 Mhz ***
#
CONFIG_ESP32_DEFAULT_CPU_FREQ_80=
CONFIG_ESP32_DEFAULT_CPU_FREQ_160=
CONFIG_ESP32_DEFAULT_CPU_FREQ_240=y
CONFIG_ESP32_DEFAULT_CPU_FREQ_MHZ=240

#
# Component => ESP-32 Specific => Panic Handler Behavior := Print registers and Halt
#
CONFIG_ESP32_PANIC_PRINT_HALT=y
CONFIG_ESP32_PANIC_PRINT_REBOOT=
CONFIG_ESP32_PANIC_SILENT_REBOOT=
CONFIG_ESP32_PANIC_GDBSTUB=

#
# Component => FreeRTOS
#
CONFIG_FREERTOS_CHECK_STACKOVERFLOW_NONE=
CONFIG_FREERTOS_CHECK_STACKOVERFLOW_PTRVAL=
CONFIG_FREERTOS_CHECK_STACKOVERFLOW_CANARY=y

#
# Component => Heap memory debugging
#
CONFIG_HEAP_POISONING_DISABLED=
CONFIG_HEAP_POISONING_LIGHT=
CONFIG_HEAP_POISONING_COMPREHENSIVE=y
CONFIG_HEAP_TRACING=

#
# Component => Log output INFO ***
#
CONFIG_LOG_DEFAULT_LEVEL_NONE=
CONFIG_LOG_DEFAULT_LEVEL_ERROR=
CONFIG_LOG_DEFAULT_LEVEL_WARN=
CONFIG_LOG_DEFAULT_LEVEL_INFO=y
CONFIG_LOG_DEFAULT_LEVEL_DEBUG=
CONFIG_LOG_DEFAULT_LEVEL_VERBOSE=
CONFIG_LOG_DEFAULT_LEVEL=3
CONFIG_LOG_COLORS=y
```

## Projects/esp32_lorabee_rx_using_lib/main/Kconfig.projbuild
```kconfig
menu "MY PROJECT configuration"


choice MY_LED_ON_DEVBOARD_GPIO_NUM
    prompt "On-board LED GPIO#"
    default MY_LED_ON_DEVBOARD_GPIO_NUM_HUZZAH32_13
    help
        The on-board LED GPIO# to be used.
config MY_LED_ON_DEVBOARD_GPIO_NUM_HUZZAH32_13
    bool "HUZZAH32_13"
config MY_LED_ON_DEVBOARD_GPIO_NUM_LOLIN32LITE_22
    bool "LOLIN32LITE_22"
config MY_LED_ON_DEVBOARD_GPIO_NUM_OTHER
    bool "Other GPIO#"
endchoice
config MY_LED_ON_DEVBOARD_GPIO_NUM_OTHER_VAL
    int "Other On-board LED GPIO#" if MY_LED_ON_DEVBOARD_GPIO_NUM_OTHER
    default 99
config MY_LED_ON_DEVBOARD_GPIO_NUM
    int
    default 13 if MY_LED_ON_DEVBOARD_GPIO_NUM_HUZZAH32_13
    default 22 if MY_LED_ON_DEVBOARD_GPIO_NUM_LOLIN32LITE_22
    default MY_LED_ON_DEVBOARD_GPIO_NUM_OTHER_VAL if MY_LED_ON_DEVBOARD_GPIO_NUM_OTHER


choice MY_LED_ON_DEVBOARD_WIRING_TYPE
    prompt "LED on-board wiring type"
    default MY_LED_ON_DEVBOARD_WIRING_TYPE_HUZZAH32_GND_1
    help
        The LED on-board wiring type to be used.
config MY_LED_ON_DEVBOARD_WIRING_TYPE_HUZZAH32_GND_1
    bool "HUZZAH32_GND_1"
config MY_LED_ON_DEVBOARD_WIRING_TYPE_LOLIN32LITE_VCC_2
    bool "LOLIN32LITE_VCC_2"
endchoice
config MY_LED_ON_DEVBOARD_WIRING_TYPE
    int
    default 1 if MY_LED_ON_DEVBOARD_WIRING_TYPE_HUZZAH32_GND_1
    default 2 if MY_LED_ON_DEVBOARD_WIRING_TYPE_LOLIN32LITE_VCC_2


config MY_LORABEE_UART_PORT_NUM
    int "MY_LORABEE_UART_PORT_NUM (1,2)"
    default 1

config MY_LORABEE_UART_TX_GPIO_NUM
    int "MY_LORABEE_UART_TX_GPIO_NUM ((Huzzah32 pin 22 @ bottomright-1))"
    default 22

config MY_LORABEE_UART_RX_GPIO_NUM
    int "MY_LORABEE_UART_RX_GPIO_NUM ((Huzzah32 pin 23 @ bottomright))"
    default 23

config MY_LORABEE_RESET_GPIO_NUM
    int "MY_LORABEE_RESET_GPIO_NUM"
    default 14

endmenu
```

## Projects/esp32_mjd_components/components/mjd_huzzah32/Kconfig
```kconfig
menu "Adafruit HUZZAH32"

config MJD_HUZZAH32_REFERENCE_VOLTAGE_MV
    int "Voltage Reference in mV [default 1100] mjd_huzzah32_get_battery_voltage()"
    default 1100

choice MJD_HUZZAH32_VOLTAGE_REGULATOR_ENABLED
    prompt "Voltage Regulator enabled? [default yes] mjd_huzzah32_get_battery_voltage()"
    default MJD_HUZZAH32_VOLTAGE_REGULATOR_ENABLED_YES
    help
        Is the Voltage Regulator enabled (default)? Without extra wiring the VR is enabled.
        This impacts the calculation of the battery voltage.
            If enabled Then no extra calculation is needed.
            If disabled Then the func multiplies the computed battery voltage with a correction factor to obtain the correct battery voltage level.
        Disabling the VR can be done by wiring the pin "EN" to "GND" to conserve power when in LiFePO4 battery mode.
        Warning: only disable the VR when using 3.3V batteries such as LifePO4 ones 
                 that are connected to the pin "3.3V" (not to the LiPO battery connector).
config MJD_HUZZAH32_VOLTAGE_REGULATOR_ENABLED_YES
    bool "Yes"
config MJD_HUZZAH32_VOLTAGE_REGULATOR_ENABLED_NO
    bool "No"
endchoice
config MJD_HUZZAH32_VOLTAGE_REGULATOR_ENABLED
    int
    default 1 if MJD_HUZZAH32_VOLTAGE_REGULATOR_ENABLED_YES
    default 0 if MJD_HUZZAH32_VOLTAGE_REGULATOR_ENABLED_NO

config MJD_HUZZAH32_ROUTE_VREF_TO_GPIO_NUM
    int "Route the Voltage Reference to this GPIO NUM [default 26] mjd_huzzah32_route_vref_to_gpio()"
    default 26

endmenu
```

## Projects/esp32_mlx90393_sensor_using_lib/main/Kconfig.projbuild
```kconfig
menu "MY PROJECT configuration"

config MY_LED_ON_DEVBOARD_GPIO_NUM
    int "LED on-board GPIO# (Huzzah32 #13) (Lolin32lite #22)"
	default 13

config MY_LED_ON_DEVBOARD_WIRING_TYPE
    int "LED on-board wiring type (Huzzah32 1=GND) (Lolin32lite 2=VCC)"
	default 1

config MY_SENSOR_I2C_MASTER_NUM
    int "MY_SENSOR_I2C_MASTER_NUM (0 = I2C_NUM_0 | 1 = I2C_NUM_1)"
	default 0

config MY_SENSOR_I2C_SLAVE_ADDRESS
    hex "MY_SENSOR_I2C_SLAVE_ADDRESS (Default 0x0C)"
	default 0x0C

config MY_SENSOR_I2C_SCL_GPIO_NUM
    int "MY_SENSOR_I2C_SCL_GPIO_NUM (Huzzah32 21 bottomleft)(Lolin32lite 13 bottomleft)"
	default 21

config MY_SENSOR_I2C_SDA_GPIO_NUM
    int "MY_SENSOR_I2C_SDA_GPIO_NUM (Huzzah32 17 bottomleft-1)(Lolin32lite 15 bottomleft-1)"
    default 17
    
config MY_SENSOR_INT_GPIO_NUM
    int "INT DRDY Data Ready pin MY_SENSOR_INT_GPIO_NUM (-1=not used)(Huzzah32 #14 bottomleft-1)(Lolin32lite #19 topright-2)"
    default 14
    
endmenu
```

## Projects/esp32_nvs_basics/sdkconfig.defaults
```kconfig
#
# Partition Table ***CUSTOM FOR THIS PROJECFT esp32_nvs_basics***
#
CONFIG_PARTITION_TABLE_SINGLE_APP=
CONFIG_PARTITION_TABLE_TWO_OTA=
CONFIG_PARTITION_TABLE_CUSTOM=y
CONFIG_PARTITION_TABLE_CUSTOM_FILENAME="partitions_esp32_nvs_basics.csv"
CONFIG_PARTITION_TABLE_CUSTOM_APP_BIN_OFFSET=0x10000
CONFIG_PARTITION_TABLE_FILENAME="partitions_esp32_nvs_basics.csv"
CONFIG_APP_OFFSET=0x10000
CONFIG_PARTITION_TABLE_MD5=y

#
# Serial flasher config
#
CONFIG_ESPTOOLPY_FLASHSIZE_1MB=
CONFIG_ESPTOOLPY_FLASHSIZE_2MB=
CONFIG_ESPTOOLPY_FLASHSIZE_4MB=y
CONFIG_ESPTOOLPY_FLASHSIZE_8MB=
CONFIG_ESPTOOLPY_FLASHSIZE_16MB=
CONFIG_ESPTOOLPY_FLASHSIZE="4MB"
CONFIG_ESPTOOLPY_FLASHSIZE_DETECT=y

#
# Compiler options
#
CONFIG_OPTIMIZATION_LEVEL_DEBUG=y
CONFIG_OPTIMIZATION_LEVEL_RELEASE=

CONFIG_STACK_CHECK_NONE=
CONFIG_STACK_CHECK_NORM=
CONFIG_STACK_CHECK_STRONG=
CONFIG_STACK_CHECK_ALL=y
CONFIG_STACK_CHECK=y

#
##
# OPTIONAL Component => ESP-32 Specific => UART... (TX RX ports are specific for Adafruit HUZZAH32)
#   @doc https://esp-idf.readthedocs.io/en/latest/api-reference/kconfig.html#envvar-CONFIG_CONSOLE_UART
#   Config meteohub for RobotDyn USBUART so I can monitor execution whilst powered by the battery (no USB link then).
#   @cmd make menuconfig:
#           UART for console output (Custom)
#           UART peripheral to use for console output (0-1) (UART0)
#           (22) UART TX on GPIO#
#           (23) UART RX on GPIO#
#           (115200) UART console baud rate
#
#####CONFIG_CONSOLE_UART_DEFAULT=
#####CONFIG_CONSOLE_UART_CUSTOM=y
#####CONFIG_CONSOLE_UART_NONE=
#####CONFIG_CONSOLE_UART_CUSTOM_NUM_0=y
#####CONFIG_CONSOLE_UART_CUSTOM_NUM_1=
#####CONFIG_CONSOLE_UART_NUM=0
#####CONFIG_CONSOLE_UART_TX_GPIO=22
#####CONFIG_CONSOLE_UART_RX_GPIO=23
#####CONFIG_CONSOLE_UART_BAUDRATE=115200

#
# Component => ESP-32 Specific => Panic Handler Behavior := Print registers and Halt
#
CONFIG_ESP32_PANIC_PRINT_HALT=y
CONFIG_ESP32_PANIC_PRINT_REBOOT=
CONFIG_ESP32_PANIC_SILENT_REBOOT=
CONFIG_ESP32_PANIC_GDBSTUB=

#
# Component => FreeRTOS
#
CONFIG_FREERTOS_CHECK_STACKOVERFLOW_NONE=
CONFIG_FREERTOS_CHECK_STACKOVERFLOW_PTRVAL=
CONFIG_FREERTOS_CHECK_STACKOVERFLOW_CANARY=y

#
# Component => Heap memory debugging
#
CONFIG_HEAP_POISONING_DISABLED=
CONFIG_HEAP_POISONING_LIGHT=
CONFIG_HEAP_POISONING_COMPREHENSIVE=y
CONFIG_HEAP_TRACING=

#
# Component => Log output
#
CONFIG_LOG_DEFAULT_LEVEL_NONE=
CONFIG_LOG_DEFAULT_LEVEL_ERROR=
CONFIG_LOG_DEFAULT_LEVEL_WARN=
CONFIG_LOG_DEFAULT_LEVEL_INFO=
CONFIG_LOG_DEFAULT_LEVEL_DEBUG=
CONFIG_LOG_DEFAULT_LEVEL_VERBOSE=y
CONFIG_LOG_DEFAULT_LEVEL=5
CONFIG_LOG_COLORS=y
```

## Projects/esp32_rmt_basics/sdkconfig.defaults
```kconfig
#
# Compiler options
#
CONFIG_OPTIMIZATION_LEVEL_DEBUG=y
CONFIG_OPTIMIZATION_LEVEL_RELEASE=

CONFIG_STACK_CHECK_NONE=
CONFIG_STACK_CHECK_NORM=
CONFIG_STACK_CHECK_STRONG=
CONFIG_STACK_CHECK_ALL=y
CONFIG_STACK_CHECK=y

#
# Component => ESP-32 Specific => Panic Handler Behavior := Print registers and Halt
#
CONFIG_ESP32_PANIC_PRINT_HALT=y
CONFIG_ESP32_PANIC_PRINT_REBOOT=
CONFIG_ESP32_PANIC_SILENT_REBOOT=
CONFIG_ESP32_PANIC_GDBSTUB=

#
# Component => FreeRTOS
#
CONFIG_FREERTOS_CHECK_STACKOVERFLOW_NONE=
CONFIG_FREERTOS_CHECK_STACKOVERFLOW_PTRVAL=
CONFIG_FREERTOS_CHECK_STACKOVERFLOW_CANARY=y

#
# Component => Heap memory debugging
#
CONFIG_HEAP_POISONING_DISABLED=
CONFIG_HEAP_POISONING_LIGHT=
CONFIG_HEAP_POISONING_COMPREHENSIVE=y
CONFIG_HEAP_TRACING=

#
# Component => Log output
#
CONFIG_LOG_DEFAULT_LEVEL_NONE=
CONFIG_LOG_DEFAULT_LEVEL_ERROR=
CONFIG_LOG_DEFAULT_LEVEL_WARN=
CONFIG_LOG_DEFAULT_LEVEL_INFO=
CONFIG_LOG_DEFAULT_LEVEL_DEBUG=
CONFIG_LOG_DEFAULT_LEVEL_VERBOSE=y
CONFIG_LOG_DEFAULT_LEVEL=5
CONFIG_LOG_COLORS=y
```
