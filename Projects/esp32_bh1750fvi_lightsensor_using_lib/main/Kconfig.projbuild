## Projects/esp32_scd30_sensor_readings_using_lib/main/Kconfig.projbuild
```kconfig
menu "MY PROJECT configuration"

###
### SCD30
config MY_SCD30_I2C_SLAVE_ADDRESS
    hex "MY_SCD30_I2C_SLAVE_ADDRESS (Default 0x61 for SCD30)"
    default 0x61

config MY_SCD30_I2C_MASTER_PORT_NUM
    int "MY_SCD30_I2C_MASTER_PORT_NUM (default 1; 0=I2C_NUM_0 | 1=I2C_NUM_1)"
    default 1

config MY_SCD30_I2C_SCL_GPIO_NUM
    int "MY_SCD30_I2C_SCL_GPIO_NUM (Huzzah32 #21=bottomleft)"
    default 21

config MY_SCD30_I2C_SDA_GPIO_NUM
    int "MY_SCD30_I2C_SDA_GPIO_NUM (Huzzah32 #17=bottomleft-1)"
    default 17

##
## OLED
choice MY_SSD1306_OLED_ENABLED
    prompt "OLED Display enabled? [default Yes]"
    default MY_SSD1306_OLED_ENABLED_YES
config MY_SSD1306_OLED_ENABLED_YES
    bool "Yes"
config MY_SSD1306_OLED_ENABLED_NO
    bool "No"
endchoice
config MY_SSD1306_OLED_ENABLED
    int
    default 1 if MY_SSD1306_OLED_ENABLED_YES
    default 0 if MY_SSD1306_OLED_ENABLED_NO

config MY_SSD1306_I2C_SLAVE_ADDRESS
    hex "MY_SSD1306_I2C_SLAVE_ADDRESS (Default 0x3C for SSD1306)"
    default 0x3C

config MY_SSD1306_I2C_MASTER_PORT_NUM
    int "MY_SSD1306_I2C_MASTER_PORT_NUM (default 0; 0=I2C_NUM_0 | 1=I2C_NUM_1)"
    default 0

config MY_SSD1306_I2C_SCL_GPIO_NUM
    int "MY_SSD1306_I2C_SCL_GPIO_NUM (Huzzah32 #23=bottomright)"
    default 23

config MY_SSD1306_I2C_SDA_GPIO_NUM
    int "MY_SSD1306_I2C_SDA_GPIO_NUM (Huzzah32 #22=bottomright-1)"
    default 22

##
## LED On-board
config MY_LED_ON_DEVBOARD_GPIO_NUM
    int "LED on-board GPIO# (Huzzah32 #13) (Lolin32lite #22)"
    default 13

config MY_LED_ON_DEVBOARD_WIRING_TYPE
    int "LED on-board wiring type (Huzzah32 1=GND) (Lolin32lite 2=VCC)"
    default 1

endmenu
```

## Projects/esp32_scd30_sensor_settings_using_lib/main/Kconfig.projbuild
```kconfig
menu "MY PROJECT configuration"

###
### SCD30 CALIBRATION
choice MY_SCD30_CALIBRATION_C
   bool "SCD30 Commands"
   default MY_SCD30_CALIBRATION_COMMAND_SHOW_SETTINGS
   help
       Specify the calibration mode for the sensor, or request to show the settings.
       Go to the README of the mjd_scd30 component for more information.

config MY_SCD30_CALIBRATION_COMMAND_SHOW_SETTINGS
   bool "Show the settings of the device"
config MY_SCD30_CALIBRATION_COMMAND_ASC_ON
   bool "Set ASC=On Activate continuous calculation of reference value for Automatic Self-Calibration"
config MY_SCD30_CALIBRATION_COMMAND_ASC_OFF
   bool "Set ASC=Off Deactivate continuous calculation of reference value for Automatic Self-Calibration"
config MY_SCD30_CALIBRATION_COMMAND_FRC
   bool "Run a FRC Forced ReCalibration in fresh air (400ppm)"
endchoice

config MY_SCD30_CALIBRATION_COMMAND
    int
    default 1 if MY_SCD30_CALIBRATION_COMMAND_SHOW_SETTINGS
    default 2 if MY_SCD30_CALIBRATION_COMMAND_ASC_ON
    default 3 if MY_SCD30_CALIBRATION_COMMAND_ASC_OFF
    default 4 if MY_SCD30_CALIBRATION_COMMAND_FRC


###
### SCD30
config MY_SCD30_I2C_SLAVE_ADDRESS
    hex "MY_SCD30_I2C_SLAVE_ADDRESS (Default 0x61 for SCD30)"
    default 0x61

config MY_SCD30_I2C_MASTER_PORT_NUM
    int "MY_SCD30_I2C_MASTER_PORT_NUM (default 1; 0=I2C_NUM_0 | 1=I2C_NUM_1)"
    default 1

config MY_SCD30_I2C_SCL_GPIO_NUM
    int "MY_SCD30_I2C_SCL_GPIO_NUM (Huzzah32 #21=bottomleft)"
    default 21

config MY_SCD30_I2C_SDA_GPIO_NUM
    int "MY_SCD30_I2C_SDA_GPIO_NUM (Huzzah32 #17=bottomleft-1)"
    default 17

##
## OLED
choice MY_SSD1306_OLED_ENABLED
    prompt "OLED Display enabled? [default Yes]"
    default MY_SSD1306_OLED_ENABLED_YES
config MY_SSD1306_OLED_ENABLED_YES
    bool "Yes"
config MY_SSD1306_OLED_ENABLED_NO
    bool "No"
endchoice
config MY_SSD1306_OLED_ENABLED
    int
    default 1 if MY_SSD1306_OLED_ENABLED_YES
    default 0 if MY_SSD1306_OLED_ENABLED_NO

config MY_SSD1306_I2C_SLAVE_ADDRESS
    hex "MY_SSD1306_I2C_SLAVE_ADDRESS (Default 0x3C for SSD1306)"
    default 0x3C

config MY_SSD1306_I2C_MASTER_PORT_NUM
    int "MY_SSD1306_I2C_MASTER_PORT_NUM (default 0; 0=I2C_NUM_0 | 1=I2C_NUM_1)"
    default 0

config MY_SSD1306_I2C_SCL_GPIO_NUM
    int "MY_SSD1306_I2C_SCL_GPIO_NUM (Huzzah32 #23=bottomright)"
    default 23

config MY_SSD1306_I2C_SDA_GPIO_NUM
    int "MY_SSD1306_I2C_SDA_GPIO_NUM (Huzzah32 #22=bottomright-1)"
    default 22

##
## LED On-board
config MY_LED_ON_DEVBOARD_GPIO_NUM
    int "On-board LED GPIO# (Huzzah32 #13) (Lolin32lite #22)"
    default 13

config MY_LED_ON_DEVBOARD_WIRING_TYPE
    int "On-board LED wiring type (Huzzah32 1=GND) (Lolin32lite 2=VCC)"
    default 1

endmenu
```

## Projects/esp32_sht3x_sensor_using_lib/main/Kconfig.projbuild
```kconfig
menu "MY PROJECT configuration"

config MY_LED_ON_DEVBOARD_GPIO_NUM
    int "LED on-board GPIO# (Huzzah32 #13) (Lolin32lite #22)"
	default 13

config MY_LED_ON_DEVBOARD_WIRING_TYPE
    int "LED on-board wiring type (Huzzah32 1=GND) (Lolin32lite 2=VCC)"
	default 1

config MY_SHT3X_I2C_SLAVE_ADDRESS
    hex "MY_SHT3X_I2C_SLAVE_ADDRESS (Default 0x44 for SHT31)"
    default 0x44

config MY_SHT3X_I2C_MASTER_PORT_NUM
    int "MY_SHT3X_I2C_MASTER_PORT_NUM (0 = I2C_NUM_0 | 1 = I2C_NUM_1)"
    default 0

config MY_SHT3X_I2C_SCL_GPIO_NUM
    int "MY_SHT3X_I2C_SCL_GPIO_NUM (Huzzah32 #21=bottomleft)"
    default 21

config MY_SHT3X_I2C_SDA_GPIO_NUM
    int "MY_SHT3X_I2C_SDA_GPIO_NUM (Huzzah32 #17=bottomleft-1)"
    default 17
    
###
###
choice MY_SHT3X_REPEATABILITY
    prompt "Repeatability Level of Measurements (0=high 1=medium 2=low)"
    default MY_SHT3X_SHT3X_REPEATABILITY_HIGH
config MY_SHT3X_SHT3X_REPEATABILITY_HIGH
    bool "0 High"
config MY_SHT3X_SHT3X_REPEATABILITY_MEDIUM
    bool "1 Medium"
config MY_SHT3X_SHT3X_REPEATABILITY_LOW
    bool "2 Low"
endchoice
config MY_SHT3X_REPEATABILITY
    int
    default 0 if MY_SHT3X_SHT3X_REPEATABILITY_HIGH
    default 1 if MY_SHT3X_SHT3X_REPEATABILITY_MEDIUM
    default 2 if MY_SHT3X_SHT3X_REPEATABILITY_LOW

endmenu
```

## Projects/esp32_spiffs_basics/sdkconfig.defaults
```kconfig
#
# Partition Table ***CUSTOM FOR THIS PROJECFT esp32_spiffs_basics***
#
CONFIG_PARTITION_TABLE_SINGLE_APP=
CONFIG_PARTITION_TABLE_TWO_OTA=
CONFIG_PARTITION_TABLE_CUSTOM=y
CONFIG_PARTITION_TABLE_CUSTOM_FILENAME="partitions_esp32_spiffs_basics.csv"
CONFIG_PARTITION_TABLE_CUSTOM_APP_BIN_OFFSET=0x10000
CONFIG_PARTITION_TABLE_FILENAME="partitions_esp32_spiffs_basics.csv"
CONFIG_APP_OFFSET=0x10000
CONFIG_PARTITION_TABLE_MD5=y

#
# Serial flasher config
#
CONFIG_ESPTOOLPY_FLASHSIZE_1MB=
CONFIG_ESPTOOLPY_FLASHSIZE_2MB=
CONFIG_ESPTOOLPY_FLASHSIZE_4MB=y
CONFIG_ESPTOOLPY_FLASHSIZE_8MB=
CONFIG_ESPTOOLPY_FLASHSIZE_16MB=
CONFIG_ESPTOOLPY_FLASHSIZE="4MB"
CONFIG_ESPTOOLPY_FLASHSIZE_DETECT=y

#
# Compiler options
#
CONFIG_OPTIMIZATION_LEVEL_DEBUG=y
CONFIG_OPTIMIZATION_LEVEL_RELEASE=

CONFIG_STACK_CHECK_NONE=
CONFIG_STACK_CHECK_NORM=
CONFIG_STACK_CHECK_STRONG=
CONFIG_STACK_CHECK_ALL=y
CONFIG_STACK_CHECK=y

#
# Component => ESP-32 Specific => Panic Handler Behavior := Print registers and Halt
#
CONFIG_ESP32_PANIC_PRINT_HALT=y
CONFIG_ESP32_PANIC_PRINT_REBOOT=
CONFIG_ESP32_PANIC_SILENT_REBOOT=
CONFIG_ESP32_PANIC_GDBSTUB=

#
# Component => FreeRTOS
#
CONFIG_FREERTOS_CHECK_STACKOVERFLOW_NONE=
CONFIG_FREERTOS_CHECK_STACKOVERFLOW_PTRVAL=
CONFIG_FREERTOS_CHECK_STACKOVERFLOW_CANARY=y

#
# Component => Heap memory debugging
#
CONFIG_HEAP_POISONING_DISABLED=
CONFIG_HEAP_POISONING_LIGHT=
CONFIG_HEAP_POISONING_COMPREHENSIVE=y
CONFIG_HEAP_TRACING=

#
# Component => Log output
#
CONFIG_LOG_DEFAULT_LEVEL_NONE=
CONFIG_LOG_DEFAULT_LEVEL_ERROR=
CONFIG_LOG_DEFAULT_LEVEL_WARN=
CONFIG_LOG_DEFAULT_LEVEL_INFO=
CONFIG_LOG_DEFAULT_LEVEL_DEBUG=
CONFIG_LOG_DEFAULT_LEVEL_VERBOSE=y
CONFIG_LOG_DEFAULT_LEVEL=5
CONFIG_LOG_COLORS=y
```

## Projects/esp32_ssd1306_oled_using_lib/main/Kconfig.projbuild
```kconfig
menu "MY PROJECT configuration"

##
## OLED SSD1306
config MY_SSD1306_I2C_SLAVE_ADDRESS
    hex "MY_SSD1306_I2C_SLAVE_ADDRESS (Default 0x3C for SSD1306)"
    default 0x3C

config MY_SSD1306_I2C_MASTER_PORT_NUM
    int "MY_SSD1306_I2C_MASTER_PORT_NUM (0 = I2C_NUM_0 | 1 = I2C_NUM_1)"
    default 0

config MY_SSD1306_I2C_SCL_GPIO_NUM
    int "MY_SSD1306_I2C_SCL_GPIO_NUM (Huzzah32 #21=bottomleft)"
    default 21

config MY_SSD1306_I2C_SDA_GPIO_NUM
    int "MY_SSD1306_I2C_SDA_GPIO_NUM (Huzzah32 #17=bottomleft-1)"
    default 17

##
## LED on-board
config MY_LED_ON_DEVBOARD_GPIO_NUM
    int "LED on-board GPIO# (Huzzah32 #13) (Lolin32lite #22)"
	default 13

config MY_LED_ON_DEVBOARD_WIRING_TYPE
    int "LED on-board wiring type (Huzzah32 1=GND) (Lolin32lite 2=VCC)"
	default 1

endmenu
```

## Projects/esp32_tmp36_sensor_ads1115_adc_using_lib/main/Kconfig.projbuild
```kconfig
menu "MY PROJECT configuration"

config MY_LED_ON_DEVBOARD_GPIO_NUM
    int "LED on-board GPIO# (Huzzah32 #13) (Lolin32lite #22)"
	default 13

config MY_LED_ON_DEVBOARD_WIRING_TYPE
    int "LED on-board wiring type (Huzzah32 1=GND) (Lolin32lite 2=VCC)"
	default 1

config MY_ADS1115_I2C_SLAVE_ADDRESS
    hex "MY_ADS1115_I2C_SLAVE_ADDRESS (Default 0x48)"
    default 0x48

config MY_ADS1115_I2C_MASTER_PORT_NUM
    int "MY_ADS1115_I2C_MASTER_PORT_NUM (0 = I2C_NUM_0 | 1 = I2C_NUM_1)"
    default 0

config MY_ADS1115_I2C_SCL_GPIO_NUM
    int "MY_ADS1115_I2C_SCL_GPIO_NUM (Huzzah32 #21=bottomleft)"
    default 21

config MY_ADS1115_I2C_SDA_GPIO_NUM
    int "MY_ADS1115_I2C_SDA_GPIO_NUM (Huzzah32 #17=bottomleft-1)"
    default 17
    
config MY_ADS1115_ALERT_READY_GPIO_NUM
    int "MY_ADS1115_ALERT_READY_GPIO_NUM (-1=not used)(Huzzah32 #16=bottomleft-2)"
    default -1

###
### 
choice MY_ADS1115_DATA_RATE
    prompt "Data Rate, Samples Per Second"
    default MY_ADS1115_DATA_RATE_8_SPS
config MY_ADS1115_DATA_RATE_8_SPS
    bool "8 SPS"
config MY_ADS1115_DATA_RATE_64_SPS
    bool "64 SPS"
config MY_ADS1115_DATA_RATE_128_SPS
    bool "128 SPS"
config MY_ADS1115_DATA_RATE_475_SPS
    bool "475 SPS"
config MY_ADS1115_DATA_RATE_860_SPS
    bool "860 SPS"
endchoice
config MY_ADS1115_DATA_RATE
    int
    default 0 if MY_ADS1115_DATA_RATE_8_SPS
    default 3 if MY_ADS1115_DATA_RATE_64_SPS
    default 4 if MY_ADS1115_DATA_RATE_128_SPS
    default 6 if MY_ADS1115_DATA_RATE_475_SPS
    default 7 if MY_ADS1115_DATA_RATE_860_SPS

endmenu
```

## Projects/esp32_udp_client/main/Kconfig.projbuild
```kconfig
menu "MY PROJECT configuration"

choice MY_LED_ON_DEVBOARD_GPIO_NUM
    prompt "On-board LED GPIO#"
    default MY_LED_ON_DEVBOARD_GPIO_NUM_HUZZAH32_13
    help
        The on-board LED GPIO# to be used.
config MY_LED_ON_DEVBOARD_GPIO_NUM_HUZZAH32_13
    bool "HUZZAH32_13"
config MY_LED_ON_DEVBOARD_GPIO_NUM_LOLIN32LITE_22
    bool "LOLIN32LITE_22"
config MY_LED_ON_DEVBOARD_GPIO_NUM_OTHER
    bool "Other GPIO#"
endchoice
config MY_LED_ON_DEVBOARD_GPIO_NUM_OTHER_VAL
    int "Other On-board LED GPIO#" if MY_LED_ON_DEVBOARD_GPIO_NUM_OTHER
    default 99
config MY_LED_ON_DEVBOARD_GPIO_NUM
    int
    default 13 if MY_LED_ON_DEVBOARD_GPIO_NUM_HUZZAH32_13
    default 22 if MY_LED_ON_DEVBOARD_GPIO_NUM_LOLIN32LITE_22
    default MY_LED_ON_DEVBOARD_GPIO_NUM_OTHER_VAL if MY_LED_ON_DEVBOARD_GPIO_NUM_OTHER


choice MY_LED_ON_DEVBOARD_WIRING_TYPE
    prompt "LED on-board wiring type"
    default MY_LED_ON_DEVBOARD_WIRING_TYPE_HUZZAH32_GND_1
    help
        The LED on-board wiring type to be used.
config MY_LED_ON_DEVBOARD_WIRING_TYPE_HUZZAH32_GND_1
    bool "HUZZAH32_GND_1"
config MY_LED_ON_DEVBOARD_WIRING_TYPE_LOLIN32LITE_VCC_2
    bool "LOLIN32LITE_VCC_2"
endchoice
config MY_LED_ON_DEVBOARD_WIRING_TYPE
    int
    default 1 if MY_LED_ON_DEVBOARD_WIRING_TYPE_HUZZAH32_GND_1
    default 2 if MY_LED_ON_DEVBOARD_WIRING_TYPE_LOLIN32LITE_VCC_2


config MY_WIFI_SSID
    string "MY_WIFI_SSID"
    default "AREA51"

config MY_WIFI_PASSWORD
    string "MY_WIFI_PASSWORD"
    default "jupijupi"    

config MY_UDP_SERVER_HOSTNAME
    string "MY_UDP_SERVER_HOSTNAME"
    default "examples: 192.168.0.94 www.google.com"

config MY_UDP_SERVER_PORT
    int "MY_UDP_SERVER_PORT"
    default 3001

endmenu
```

## Projects/esp32_wifi_device_scanner/main/Kconfig.projbuild
```kconfig
menu "MY PROJECT configuration"

config MY_LED_ON_DEVBOARD_GPIO_NUM
    int "LED on-board GPIO# (Huzzah32 #13) (Lolin32lite #22)"
	default 13

config MY_LED_ON_DEVBOARD_WIRING_TYPE
    int "LED on-board wiring type (Huzzah32 1=GND) (Lolin32lite 2=VCC)"
	default 1

endmenu
```
